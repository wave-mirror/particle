OUTPUT_FORMAT("elf32-littlearm", "elf32-littlearm", "elf32-littlearm")
OUTPUT_ARCH(arm)

INCLUDE memory.ld

/* # Entry point = reset vector */
ENTRY(reset);
EXTERN(__RESET_VECTOR); /* depends on the `reset` symbol */

/* # Pre-initialization function */
/* If the user overrides this using the `pre_init!` macro or by creating
   a `__pre_init` function, then the function this points to will be called
   before the RAM is initialized. */
PROVIDE(__pre_init = default_pre_init);

SECTIONS
{
    PROVIDE(_stack_start = ORIGIN(RAM) + LENGTH(RAM));

    /* ## Sections in ROM */
    /* ### Vector table */
    .vector_table ORIGIN(ROM) :
    {
        /* Initial Stack Pointer (SP) value */
        LONG(_stack_start);

        /* Reset vector */
        KEEP(*(.vector_table.reset_vector));
        __reset_vector = .;

        /* Exceptions */
        KEEP(*(.vector_table.exceptions));
        __exceptions = .;


        /* Device s pecific interrupts */
        KEEP(*(.vector_table.interrupts));
    } > ROM

    PROVIDE(_stext = ADDR(.vector_table) + SIZEOF(.vector_table));

    /* ### .text */
    .text _stext :
    {
        *(.text .text.*);
    } > ROM

    /* ### .rodata */
    .rodata : ALIGN(4)
    {
        *(.rodata .rodata.*);

        /* 4-byte align the end (VMA) of this section.
           This is required by LLD to ensure the LMA of the following
           .data section will have the correct alignment. */
        . = ALIGN(4);
    } > ROM

    /* ## Sections in RAM */
    /* ### .data */
    .data : ALIGN(4)
    {
        . = ALIGN(4);
        __sdata = .;
        *(.data .data.*);
        . = ALIGN(4); /* 4-byte align the end (VMA) of this section */
        __edata = .;
    } > RAM AT > ROM

    /* LMA of .data */
    __sidata = LOADADDR(.data);

    /* ### .bss */
    .bss : ALIGN(4)
    {
        . = ALIGN(4);
        __sbss = .;
        *(.bss .bss.*);
        . = ALIGN(4);
        __ebss = .;
    } > RAM

    /* ## .got */
    /* Dynamic reloactions are unsupported. This section is only used to
       detect relocatable code in the input files and raise an error if
       relocatable code is found. */
    .got (NOLOAD) :
    {
        KEEP(*(.got .got.*));
    }

    /* ## Discarded sections */
    /DISCARD/ :
    {
        /* Unused exception related info that only wastes space */
        *(.ARM.exidx);
        *(.ARM.exidx.*);
        *(.ARM.extab.*);
    }
}
